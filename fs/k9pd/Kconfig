## fs/k9pd/Kconfig
```kconfig
config 9P_SERVER
	tristate "9P server support (EXPERIMENTAL)"
	depends on INET
	depends on RUST
	default n
	help
	  Choose Y here if you want to allow 9P compliant clients
	  to access files residing on this system using the 9P protocol.
	  To compile the 9P server support as a module,
	  choose M here: the module will be called k9pd.
```

## fs/rust-ext2/Kconfig
```kconfig
# SPDX-License-Identifier: GPL-2.0-only
#

config RUST_EXT2_FS
	tristate "Rust second extended fs support"
	depends on RUST && BLOCK
	help
	  Ext2 is a standard Linux file system for hard disks.

	  To compile this file system support as a module, choose M here: the
	  module will be called rust_ext2.

	  If unsure, say Y.
```
